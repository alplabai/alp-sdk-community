## CMakeLists.txt
```
# SPDX-License-Identifier: Apache-2.0
cmake_minimum_required(VERSION 3.20.0)

find_package(Zephyr REQUIRED HINTS $ENV{ZEPHYR_BASE})
project(pcf8574_basic)

target_sources(app PRIVATE src/main.c)
```

## prj.conf
```kconfig
CONFIG_ALP_SDK=y
CONFIG_I2C=y
CONFIG_ALP_SDK_CHIP_PCF8574=y
```

## src/main.c
```c
/*
 * Copyright 2026 ALP Lab AB
 * SPDX-License-Identifier: Apache-2.0
 *
 * Tier 2 alp-sdk-community minimum-viable example for pcf8574.
 */

#include <zephyr/kernel.h>
#include <zephyr/sys/printk.h>

#include "alp/peripheral.h"
#include "alp/e1m_pinout.h"
#include "pcf8574.h"

int main(void)
{
    printk("pcf8574 Tier 2 demo\n");
    alp_i2c_t *bus = alp_i2c_open(&(alp_i2c_config_t){
        .bus_id     = E1M_I2C0,
        .bitrate_hz = 400000,
    });
    if (bus == NULL) {
        printk("FAIL: alp_i2c_open returned NULL\n");
        return 1;
    }
    pcf8574_t dev;
    alp_status_t s = pcf8574_init(&dev, bus, PCF8574_I2C_ADDR_DEFAULT);
    printk("init returned %d\n", s);
    pcf8574_deinit(&dev);
    alp_i2c_close(bus);
    return 0;
}
```
