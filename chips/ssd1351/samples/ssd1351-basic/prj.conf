## CMakeLists.txt
```
# SPDX-License-Identifier: Apache-2.0
cmake_minimum_required(VERSION 3.20.0)

find_package(Zephyr REQUIRED HINTS $ENV{ZEPHYR_BASE})
project(ssd1351_basic)

target_sources(app PRIVATE src/main.c)
```

## prj.conf
```kconfig
CONFIG_ALP_SDK=y
CONFIG_SPI=y
CONFIG_GPIO=y
CONFIG_ALP_SDK_CHIP_SSD1351=y
```

## src/main.c
```c
/*
 * Copyright 2026 ALP Lab AB
 * SPDX-License-Identifier: Apache-2.0
 *
 * Tier 2 alp-sdk-community minimum-viable example for ssd1351.
 */

#include <zephyr/kernel.h>
#include <zephyr/sys/printk.h>

#include "alp/peripheral.h"
#include "ssd1351.h"

int main(void)
{
    printk("ssd1351 Tier 2 demo (init-only)\n");
    ssd1351_t dev;
    alp_status_t s = ssd1351_init(&dev, NULL, NULL);  /* NULL-arg path */
    printk("init returned %d (expected ALP_ERR_INVAL)\n", s);
    ssd1351_deinit(&dev);
    return 0;
}
```
